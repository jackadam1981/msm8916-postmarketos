/dts-v1/;

/ {
    model = "Sample MSM8916 Multi-ID Device";
    compatible = "qcom,msm8916";
    qcom,msm-id = <0xce 0x0 0xf8 0x0 0xf9 0x0 0xfa 0x0>;
    qcom,board-id = <0x08 0x100>;
    qcom,pmic-id = <0x10009 0x1000a 0x0 0x0>;
};
